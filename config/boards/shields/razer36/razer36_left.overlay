#include "razer36.dtsi"

//May need to add the col-gpios and flip it as in the crkbd example		

&kscan {
	col-gpios
		= <&shift_reg 0 (GPIO_ACTIVE_HIGH)>
		, <&shift_reg 1 (GPIO_ACTIVE_HIGH)>
	    , <&shift_reg 2 (GPIO_ACTIVE_HIGH)>
		, <&shift_reg 3 (GPIO_ACTIVE_HIGH)>
		, <&shift_reg 4 (GPIO_ACTIVE_HIGH)>
		, <&shift_reg 5 (GPIO_ACTIVE_HIGH)>;
};