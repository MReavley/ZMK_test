## config/boards/shields/razer36/Kconfig.defconfig
```kconfig
if SHIELD_razer36_left

config ZMK_KEYBOARD_NAME
		default "razer36"
	
config ZMK_SPLIT_ROLE_CENTRAL
		default y
		
config SPI
		default y

endif	

if SHIELD_razer36_left || SHIELD_razer36_right	

config I2C 
		default y

config ZMK_SPLIT
		default y

config SPI
		default y


config ZMK_KSCAN_MATRIX_POLLING
		default y


endif #overall		
```

## config/boards/shields/razer36/Kconfig.shield
```kconfig
# Test_001

config SHIELD_razer36_left
	def_bool $(shields_list_contains,razer36_left)
	select SPI
	
config SHIELD_razer36_right
	def_bool $(shields_list_contains,razer36_right)
	select SPI
```
